## firmware/buildroot/ngfw_defconfig
```kconfig
#
# NGFW Buildroot Configuration
# Build system for embedded NGFW firmware
#

# Buildroot version
BR2_VERSION="2024.02.1"

# Architecture
BR2_arm64=y
BR2_ARCH="aarch64"
BR2_TARGET_ARCH="arm64"

# System
BR2_TARGET_GENERIC_HOSTNAME="ngfw"
BR2_TARGET_GENERIC_DOMAIN="localdomain"
BR2_TARGET_GENERIC_ROOTFS="ext4"
BR2_TARGET_GENERIC_RECMAKE="y"
BR2_TARGET_GENERIC_PASSWD_HASH="sha512"
BR2_TARGET_GENERIC_PASSWD_METHOD="shadow"

# Build options
BR2_OPTIMIZE_2=y
BR2_OPTIMIZE_3=y
BR2_TARGET_LITTLE_ENDIAN=y
BR2_TARGET_GENERIC_UTS_RELEASE="6.1-ngfw"

# Kernel
BR2_LINUX_KERNEL=y
BR2_LINUX_KERNEL_CUSTOM_VERSION=y
BR2_LINUX_KERNEL_VERSION="6.1.80"
BR2_LINUX_KERNEL_DEFCONFIG="ngfw"
BR2_LINUX_KERNEL_CONFIG_FRAGMENT_FILES=""

# Linux headers
BR2_KERNEL_HEADERS_VERSION=y
BR2_DEFAULT_KERNEL_HEADERS="6.1.80"

# Init system
BR2_INIT_SYSTEMD=y
BR2_SYSTEM_DHCP="eth0"
BR2_TARGET_GENERIC_GETTY_PORT="ttyAMA0"
BR2_TARGET_GENERIC_GETTY_BAUDRATE="115200"

# Toolchain
BR2_TOOLCHAIN_EXTERNAL=y
BR2_TOOLCHAIN_EXTERNAL_Linaro_AArch64=y
BR2_TOOLCHAIN_EXTERNAL_CUSTOM_PREFIX="aarch64-linux-gnu"
BR2_TOOLCHAIN_EXTERNAL_GCC_13=y
BR2_TOOLCHAIN_EXTERNAL_UCLIBC=n

# Firmware size
BR2_TARGET_ROOTFS_EXT2=y
BR2_TARGET_ROOTFS_EXT2_4=y
BR2_TARGET_ROOTFS_EXT2_SIZE="512M"

# System packages
BR2_PACKAGE_BUSYBOX=y
BR2_PACKAGE_BUSYBOX_CONFIG="package/busybox/busybox-minimal.config"

# Network
BR2_PACKAGE_IPTABLES=y
BR2_PACKAGE_IPSET=y
BR2_PACKAGE_ETHTOOL=y
BR2_PACKAGE_IPROUTE2=y
BR2_PACKAGE_IFUPLOAD=y

# System tools
BR2_PACKAGE_E2FSPROGS=y
BR2_PACKAGE_UTIL_LINUX=y
BR2_PACKAGE_UBUS=y
BR2_PACKAGE_JSON_C=y

# NGFW Application
BR2_PACKAGE_NGFW_APP=y
BR2_PACKAGE_NGFW_APP_PATH="/mnt/public_home/work/research/ngfw"

# SSL/TLS
BR2_PACKAGE_OPENSSL=y
BR2_PACKAGE_OPENSSL_BIN=y
BR2_PACKAGE_OPENSSL_ENGINES=y
BR2_PACKAGE_CURL=y

# SNMP
BR2_PACKAGE_NETSNMP=y
BR2_PACKAGE_NETSNMP_UTILITIES=y

# Logging
BR2_PACKAGE_RSYSLOG=y
BR2_PACKAGE_RSYSLOG_UDP=y
BR2_PACKAGE_RSYSLOG_TCP=y

# Compression
BR2_PACKAGE_ZLIB=y
BR2_PACKAGE_LZ4=y

# Development
BR2_PACKAGE_GDB=n
BR2_PACKAGE_STRACE=n

# Runtime
BR2_TARGET_GENERIC_ROOTFS_OVERLAY=""
BR2_ROOTFS_OVERLAY="board/ngfw/overlay"

# Output
BR2_DL_DIR="/mnt/public_home/work/research/ngfw/firmware/buildroot/dl"
BR2_BUILD_DIR="/mnt/public_home/work/research/ngfw/firmware/buildroot/build"
BR2_HOST_DIR="/mnt/public_home/work/research/ngfw/firmware/buildroot/host"

# Legal
BR2_COPY_GPLV3=y
BR2_LICENSE_FILES="COPYING" 

# Binary format
BR2_BINUTILS_VERSION_2_41_X=y
BR2_GCC_VERSION_13_X=y
BR2_BINUTILS_SUPPORTS_AVE=y
```

## firmware/uboot/ngfw_defconfig
```kconfig
#
# NGFW U-Boot Configuration
# Bootloader configuration for ARM64 NGFW device
#

CONFIG_ARM64=y
CONFIG_ARCH_VIRT=y
CONFIG_TARGET_VIRT=y

# System
CONFIG_SYS_TEXT_BASE=0x40080000
CONFIG_SYS_MALLOC_LEN=0x4000000
CONFIG_SYS_MEM_TOP=

# Boot
CONFIG_BOOTDELAY=3
CONFIG_BOOTCOMMAND="setenv bootargs console=ttyAMA0,115200 root=/dev/mmcblk0p2 rw rootwait; bootm 0x5000000"
CONFIG_BOOTFILE="boot.itb"
CONFIG_LOADADDR=0x5000000

# Console
CONFIG_CONS_INDEX=0
CONFIG_BAUDRATE=115200
CONFIG_SYS_BAUDRATE=115200

# Serial
CONFIG_DEBUG_UART_BASE=0x9000000
CONFIG_DEBUG_UART_CLOCK=24000000

# Memory
CONFIG_NR_DRAM_BANKS=2
CONFIG_SYS_SDRAM_BASE=0x40000000
CONFIG_SYS_SDRAM_SIZE=0x400000000

# MMC/SD
CONFIG_MMC=y
CONFIG_MMC_SUNXI=y
CONFIG_MMC_SUNXI_USE_DMA=y

# Network
CONFIG_NET=y
CONFIG_NET_MULTI=y
CONFIG_E1000=y
CONFIG_RGMII=y

# LED
CONFIG_LED=y
CONFIG_LED_STATUS=y
CONFIG_STATUS_LED=y
CONFIG_STATUS_LED_GREEN=y

# GPIO
CONFIG_DM_GPIO=y

# SPI Flash
CONFIG_SPI=y
CONFIG_MTD=y
CONFIG_MTD_NOR_DRIVER=y
CONFIG_MTD_SPI_NOR=y
CONFIG_SPI_FLASH=y
CONFIG_SPI_FLASH_STMICRO=y
CONFIG_SPI_FLASH_MACRONIX=y

# Environment
CONFIG_ENV_IS_IN_MMC=y
CONFIG_ENV_IS_IN_SPI_FLASH=y
CONFIG_ENV_SIZE=0x10000
CONFIG_ENV_OFFSET=0x100000
CONFIG_ENV_SECT_SIZE=0x10000

# Boot menu
CONFIG_MENU=y

# Fastboot
CONFIG_FASTBOOT=y
CONFIG_FASTBOOT_FLASH=y
CONFIG_FASTBOOT_DOWNLOAD=y

# Android boot
CONFIG_ANDROID_BOOT=y

# USB
CONFIG_USB=y
CONFIG_USB_EHCI_HCD=y
CONFIG_USB_STORAGE=y

# DFU
CONFIG_DFU=y
CONFIG_DFU_TFTP=y

# File systems
CONFIG_FAT=y
CONFIG_EXT4=y

# Load image
CONFIG_DOS_PARTITION=y
CONFIG_ISO_PARTITION=y

# Boot image types
CONFIG_FIT=y
CONFIG_FIT_VERBOSE=y
CONFIG_FIT_BEST_MATCH=y

# Image formats
CONFIG_ZIMAGE=y
CONFIG_IMAGE_FORMAT_LEGACY=y

# Compression
CONFIG_LZMA=y
CONFIG_LZO=y
CONFIG_GZIP=y
CONFIG_LZO=y

# Distro boot
CONFIG_DISTRO_DEFAULTS=y

# Environment variables
CONFIG_BOOTARGS="console=ttyAMA0,115200 earlycon=pl011,0x9000000,115200 root=/dev/mmcblk0p2 rw rootwait init=/sbin/init"

# Network settings
CONFIG_IPADDR=192.168.1.100
CONFIG_SERVERIP=192.168.1.1
CONFIG_NETMASK=255.255.255.0
CONFIG_GATEWAY=192.168.1.1
CONFIG_HOSTNAME="ngfw"

# Boot targets
CONFIG_BOOT_TARGETS_0="mmc"
CONFIG_BOOT_TARGETS_1="usb"
CONFIG_BOOT_TARGETS_2="pxe"

# Splash screen
CONFIG_SPLASH_SCREEN=y

# Debug
CONFIG_DEBUG=y
CONFIG_LOG=y
CONFIG_LOG_DEFAULT_LEVEL=7

# Power management
CONFIG_PMIC=y
CONFIG_PWM=y
CONFIG_SPMI=y

# Watchdog
CONFIG_WATCHDOG=y

# Cryptography
CONFIG_AES=y
CONFIG_DES=y
CONFIG_SHA1=y
CONFIG_SHA256=y
```
